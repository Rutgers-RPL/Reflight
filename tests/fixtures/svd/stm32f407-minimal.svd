# STM32F407VG register map
File version: 1.0
Minimal Reflight STM32F407VG register fixture
Registers are access not given, no defined reset value unless marked. A register's access mark holds for its fields unless they carry their own. Offsets are from the block's base; lines under a group give offsets from that group; [hi:lo] are bit positions; {n}, {i} and the like mark numbered series; 'fields as' and 'values as' point back to an identical list; <NAME> marks a mode.

## Memory map
0x40004400 USART2 — Serial output
0x40005400 I2C1 — I2C bus
0x40011000 USART1 — Derived serial output
0x40013000 SPI1 — SPI bus
0x40020000 GPIOA — GPIO port A
0x40020400 GPIOB — Derived GPIO port B
0x40023800 RCC — Reset and clock control

## SPI1 — SPI bus
Base 0x40013000
0x00 CR1
0x04 CR2
0x08 SR
0x0C DR 16-bit — Data register
  [15:0] DATA
{0x20+4i} TEST{i} (i=0..1) — Array test

## I2C1 — I2C bus
Base 0x40005400
0x10 DR

## USART2 — Serial output
Base 0x40004400
Same registers: USART1 0x40011000
0x00 SR
0x04 DR
0x08 BRR
0x0C CR1

## GPIOA — GPIO port A
Base 0x40020000
Same registers: GPIOB 0x40020400
0x00 MODER
0x14 ODR
0x18 BSRR

## RCC — Reset and clock control
Base 0x40023800
0x30 AHB1ENR
0x40 APB1ENR
0x44 APB2ENR
